## sources/meta-duke-beagle/conf/bblayers.conf.sample
```bitbake
# POKY_BBLAYERS_CONF_VERSION is increased each time build/conf/bblayers.conf
# changes incompatibly
POKY_BBLAYERS_CONF_VERSION = "2"

BBPATH = "${TOPDIR}"
BBFILES ?= ""

BBLAYERS ?= " \
  ${TOPDIR}/../sources/meta \
  ${TOPDIR}/../sources/meta-poky \
  ${TOPDIR}/../sources/meta-yocto-bsp \
  ${TOPDIR}/../sources/meta-opemembedded \
  ${TOPDIR}/../sources/meta-duke-beagle \
  "
```

## sources/meta-duke-beagle/conf/distro/duke.conf
```bitbake
require conf/distro/poky.conf

# Use systemd and glibc for standard behavior
TCLIBC = "glibc"
INIT_MANAGER ?= "systemd"

# Distro config is evaluated after the machine config, so we have to explicitly
# set the kernel provider to override a machine config.
PREFERRED_PROVIDER_virtual/kernel = "linux-yocto"
PREFERRED_VERSION_linux-yocto ?= "5.15%"

DISTRO_FEATURES_NET = "ipv4"
DISTRO_FEATURES_USB = "usbhost"
#DISTRO_FEATURES_WIFI = "wifi"

DISTRO_FEATURES = "\
    ipv4 \
    systemd \
"

DISTRO_FEATURES:class-native = "${DISTRO_FEATURES_DEFAULT} ${POKY_DEFAULT_DISTRO_FEATURES}"
DISTRO_FEATURES:class-nativesdk = "${DISTRO_FEATURES_DEFAULT} ${POKY_DEFAULT_DISTRO_FEATURES}"

IMAGE_FEATURES:append = "\
    ssh-server-dropbear \
"

# Image formats are still fairly simple
IMAGE_FSTYPES = "cpio.gz wic"
QB_DEFAULT_FSTYPE = "cpio.gz"
```

## sources/meta-duke-beagle/conf/layer.conf
```bitbake
# We have a conf and classes directory, add to BBPATH
BBPATH .= ":${LAYERDIR}"

# We have a recipes directory, add to BBFILES
BBFILES += "${LAYERDIR}/recipes-*/*/*.bb \
	${LAYERDIR}/recipes-*/*/*.bbappend"

BBFILE_COLLECTIONS += "duke-beagle"
BBFILE_PATTERN_duke-beagle := "^${LAYERDIR}/"
BBFILE_PRIORITY_duke-beagle = "6"

LAYERSERIES_COMPAT_duke-beagle = "kirkstone"

LAYERDEPENDS_duke-beagle = "core"
```
